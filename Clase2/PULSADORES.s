SYSCTL_RCGCGPIO_R	EQU 0x400FE608 ; INICIO DEL RELOJ
GPIO_PORTF_AMSEL_R	EQU 0x40025528 ; ELIMINA EL ANALOGO DEL PUERTO F
GPIO_PORTF_PCTL_R	EQU 0x4002552C ; CONFIGURACION GPIO
GPIO_PORTF_DIR_R	EQU 0x40025400 ; DIRECCION DEL REGISTRO
GPIO_PORTF_AFSEL_R	EQU 0x40025420 ; ELIMINA CUALQUIER OTRA SEсAL DEL PUERTO
GPIO_PORTF_DEN_R	EQU 0x4002551C ; PUERTOS DIGITALES
PF0					EQU 0x40025004 ; HABILITACION DEL PUERTO F0
PF12				EQU 0x40025018 ; HABILITACION DEL PUERTO F12
GPIO_PORTF_LOCK_R	EQU 0x40025520 ; CODIGO DE DESBLOQUEO
GPIO_LOCK_KEY		EQU 0x4C4F434B ; LLAVE PARA DESBLOQUEO
GPIO_PORF_CR_R		EQU 0x40025524
CONSTANTE			EQU 1000000

	AREA codigo, CODE, READONLY, ALIGN=2
	THUMB ; ES ELQUE DEFINE EL USO DE LAS INSTRUCCIONES
	
	EXPORT Start ;DECLARACION DE Start COMO GLOBAL
		
Start ;PUNTO DE ENTRADA A PARTIR DEL STARTUP
;PASO 1: ACTIVACION DEL RELOJ PARA PUERTO F
	LDR R1, =SYSCTL_RCGCGPIO_R
	LDR R0, [R1]
	ORR R0, R0,#0x20
	STR R0, [R1]
	NOP
	NOP
;PASO 2: DESBLOQUEO DE PINES. EN ESTE CASO LOS PINES ESTAN LIBRES
	LDR R1, =GPIO_PORTF_LOCK_R
	LDR R0, =GPIO_LOCK_KEY	
	STR R0, [R1]
	LDR R1, =GPIO_PORF_CR_R
	MOV R0, #0xFF
	STR R0, [R1]
;PASO 3: DESHABILITAR FUNCION ANALOGICA
	LDR R1, =GPIO_PORTF_AMSEL_R
	LDR R0, [R1]
	BIC R0, R0,#0x07
	STR R0, [R1]
;PASO 4; CONFIGURACION DEL GPIO, PCTL=0
	LDR R1, =GPIO_PORTF_PCTL_R
	LDR R0, [R1]
	BIC R0, R0,#0x000000FF
	BIC R0, R0,#0x00000F00
	STR R0, [R1]
;PASO 5: ESPECIFICAR LA DIRECCION PF12
	LDR R1, =GPIO_PORTF_DIR_R
	LDR R0, [R1]
	ORR R0, R0,#0x06
	STR R0, [R1]
;PASO 5: ESPECIFICAR LA DIRECCION PF0
	LDR R1, =GPIO_PORTF_DIR_R
	LDR R0, [R1]
	ORR R0, R0,#0x01
	STR R0, [R1]
;PASO 6: LIMPIAR LOS BITS EN FUNCION ALTERNATIVA
	LDR R1, =GPIO_PORTF_AFSEL_R
	LDR R0, [R1]
	BIC R0, R0,#0x07
	STR R0, [R1]
;PASO 7: HABILITAR EL PUERTO DIGITAL
	LDR R1, =GPIO_PORTF_DEN_R
	LDR R0, [R1]
	BIC R0, R0,#0x07
	STR R0, [R1]
	
	
	LDR R3, =CONSTANTE
	B Loop
	
PAUSA ;RETARDO DE 1/2 s
	ADD R2, #1
	NOP
	NOP
	NOP
	NOP
	CMP R2, R3
	BNE PAUSA
	BX LR ;BIFURCACION, DETERMINA EL ESTADO DEL PROCESADOR

ENCENDIDO
	 LDR R3, =PF12
	 LDR R4, =0x06
	 STR R4, [R5]
	 B Loop

APAGADO
	 LDR R3, =PF12
	 LDR R4, =0x00
	 STR R4, [R5]
	 B Loop
	 
Loop ;CICLO PARA ENCENDER Y APAGAR EL LED 
;CARGAR EN R0 EL CONTENIDO DE LA DIRECCION DE MEMORIA A LA QUE 
;APUNTA R1 (PF2)
	LDR R1, =PF0
	LDR R0, [R1]
	
	LDR R2, =0
	;IF(F0=1) ENCENDER EL LED, IF(F0=0) APAGAR EL LED
	CMP R0,#0x01
	BEQ ENCENDIDO
	CMP R0,#0x00
	BEQ APAGADO

	B Loop
	
	ALIGN 
	END